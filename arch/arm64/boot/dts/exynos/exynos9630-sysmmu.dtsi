/*
 * SAMSUNG EXYNOS9610 SoC device tree source
 *
 * Copyright (c) 2018 Samsung Electronics Co., Ltd.
 *		http://www.samsung.com
 *
 * SAMSUNG EXYNOS9610 SoC device nodes are listed in this file.
 * EXYNOS9610 based board files can include this file and provide
 * values for board specfic bindings.
 *
 * This program is free software; you can redistribute it and/or modify
 * it under the terms of the GNU General Public License version 2 as
 * published by the Free Software Foundation.
 */

#include <dt-bindings/interrupt-controller/arm-gic.h>
#include <dt-bindings/interrupt-controller/exynos9630.h>
#include <dt-bindings/sysmmu/sysmmu.h>

/ {
	sysmmu_dpu: sysmmu@14900000 {
		compatible = "samsung,exynos-sysmmu";
		reg = <0x0 0x14900000 0x9000>;
		interrupts = <0 INTREQ__SMMU_DPU_S1_NS 0>,
			     <0 INTREQ__SMMU_DPU_S1_S 0>;
		qos = <15>;
		port-name = "DPU";
		sysmmu,secure-irq;
		sysmmu,secure_base = <0x14930000>;
		#iommu-cells = <0>;
	};
};
