/*
 * SAMSUNG EXYNOS9630 SoC device tree source
 *
 * Copyright (c) 2019 Samsung Electronics Co., Ltd.
 *		http://www.samsung.com
 *
 * SAMSUNG EXYNOS9630 SoC device nodes are listed in this file.
 * EXYNOS9630 based board files can include this file and provide
 * values for board specfic bindings.
 *
 * This program is free software; you can redistribute it and/or modify
 * it under the terms of the GNU General Public License version 2 as
 * published by the Free Software Foundation.
 */

#include <dt-bindings/interrupt-controller/exynos9630.h>

/ {
	debug-snapshot-soc {
		compatible = "debug-snapshot-soc";
		#address-cells = <1>;
		#size-cells = <1>;
	};
};
