/*
 * SAMSUNG EXYNOS9810 MALI device tree sourceA
 *
 * Copyright (c) 2019 Samsung Electronics Co., Ltd.
 *     http://www.samsung.com
 *
 * This program is free software; you can redistribute it and/or modify
 * it under the terms of the GNU General Public License version 2 as
 * published by the Free Software Foundation.
 */

/ {
	/* mali */
        mali: mali@11500000 {
        compatible = "arm,mali";
        reg = <0x0 0x11500000 0x5000>;
        interrupts = <GIC_SPI INTREQ__G3D_IRQJOB IRQ_TYPE_LEVEL_HIGH>,
                   <GIC_SPI INTREQ__G3D_IRQMMU IRQ_TYPE_LEVEL_HIGH>,
                   <GIC_SPI INTREQ__G3D_IRQGPU IRQ_TYPE_LEVEL_HIGH>;
        interrupt-names = "JOB", "MMU", "GPU";
        g3d_cmu_cal_id = <ACPM_DVFS_G3D>;
        power-domains = <&pd_g3d>;
        g3d_genpd_name = "pd-g3d";
        #cooling-cells = <2>; /* min followed by max */
        governor = "interactive";
        interactive_info = <377000 75 0>;
        gpu_dvfs_table_size = <6 7>; /*<row col>*/
        /*  8 columns          freq  down   up stay     mif  little     big  */
        gpu_dvfs_table = <  1001000    95  100   1  1539000 2002000       0
                             865000    80   90   1  1539000 2002000       0
                             754000    80   90   1  1352000 1456000       0
                             598000    70   90   1  1014000 1053000       0
                             433000    60   80   1   845000  806000       0
                             377000     0   70   1   676000  650000       0  >;
        gpu_sustainable_info = <0 0 0 0 0>;
        gpu_pmqos_cpu_cluster_num = <2>;
        gpu_pmu_status_reg_offset = <0x1d04>;
        gpu_pmu_status_local_pwr_mask = <0x1>; /*0x1 << 0*/
        gpu_max_clock = <1001000>;
        gpu_max_clock_limit = <1001000>;
        gpu_min_clock = <377000>;
        gpu_dvfs_start_clock = <377000>;
        gpu_dvfs_bl_config_clock = <377000>;
        gpu_default_voltage = <800000>;
        gpu_cold_minimum_vol = <0>;
        gpu_voltage_offset_margin = <37500>;
        gpu_tmu_control = <1>;
        gpu_temp_throttling_level_num = <6>;
        gpu_temp_throttling = <598000 433000 377000 156000 100000 100000>;
        gpu_power_coeff = <625>;
        gpu_dvfs_time_interval = <5>; /*1 tick : 10ms*/
        gpu_default_wakeup_lock = <1>;
        gpu_dynamic_abb = <0>;
        gpu_early_clk_gating = <0>;
        gpu_dvs = <0>;
        gpu_inter_frame_pm = <0>;
        gpu_perf_gathering = <0>;
        gpu_runtime_pm_delay_time = <50>;
        gpu_dvfs_polling_time = <30>;
        gpu_pmqos_int_disable = <1>;
        gpu_pmqos_mif_max_clock = <2094000>;
        gpu_pmqos_mif_max_clock_base = <650000>;
        gpu_cl_dvfs_start_base = <377000>;
        gpu_debug_level = <3>; /*DEBUG(1) INFO(2) WARNING(3) ERROR(4)*/
        gpu_trace_level = <8>; /*TRACE_ALL*/
        gpu_mo_min_clock = <377000>;
        gpu_boost_gpu_min_lock = <0>;
        gpu_boost_egl_min_lock = <1872000>;
        gpu_vk_boost_max_lock = <325000>;
        gpu_vk_boost_mif_min_lock = <1014000>;
        gpu_bts_support = <1>;
        gpu_power_off_clock = <377000>;
    };
};
