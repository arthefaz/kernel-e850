## arch/arm64/configs/erd3830_defconfig
```kconfig
#
# ERD3830 board specific configuration
#

CONFIG_SCSC_WLBT_CONFIG_PLATFORM="nacho_s612_erd"
CONFIG_SND_SOC_SAMSUNG_EXYNOS3830_SOUND=y
#CONFIG_NFC=y
#CONFIG_SEC_NFC=y
#CONFIG_SEC_NFC_PRODUCT_N5=y
#CONFIG_SEC_NFC_IF_I2C=y
#CONFIG_SEC_NFC_GPIO_CLK=y
#CONFIG_SEC_NFC_LDO_EN=y
```

## arch/arm64/configs/erd3830_t_defconfig
```kconfig
# CONFIG_CMDLINE_EXTEN is not set
CONFIG_SOC_EXYNOS3830_ANDROID_VERSION_T=y

#USB
# CONFIG_USB_NOTIFY_LAYER_LSI is not set
# CONFIG_USB_NOTIFY_LAYER_MODULE is not set
# CONFIG_USB_NOTIFIER is not set

#Audio
CONFIG_SND_SOC_SAMSUNG_EXYNOS3830_SOUND=m

#CAMERA
# CONFIG_CAMERA_CIS_GM1SP_OBJ is not set
# CONFIG_CAMERA_CIS_4H5YC_OBJ is not set
# CONFIG_CAMERA_CIS_5E9_OBJ is not set
# CONFIG_CAMERA_ACT_DW9839_OBJ is not set
# CONFIG_CAMERA_FLASH_S2MU106_OBJ is not set

# IF PMIC
# CONFIG_ERD_USE_S2M_MUIC is not set
# CONFIG_ERD_MUIC_SYSFS is not set
# CONFIG_ERD_MUIC_CORE is not set
# CONFIG_ERD_MUIC_MANAGER is not set
# CONFIG_ERD_MUIC_S2MU106 is not set
# CONFIG_ERD_MUIC_SUPPORT_CCIC is not set
# CONFIG_ERD_MUIC_SUPPORT_PRSWAP is not set

# CONFIG_ERD_USE_S2M_PDIC is not set
# CONFIG_ERD_PDIC_S2MU106 is not set
# CONFIG_ERD_PDIC_AUDIO_ACC is not set
# CONFIG_ERD_CHECK_CTYPE_SIDE is not set
# CONFIG_ERD_SUPPORT_USB_TYPEC_OPS is not set
# CONFIG_ERD_PDIC_SUPPORT_DP is not set

# CONFIG_ERD_IFCONN_NOTIFIER_MODULE is not set
# CONFIG_ERD_IFCONN_NOTIFIER is not set
# CONFIG_ERD_IFCONN_MANAGER is not set

# CONFIG_ERD_FUELGAUGE_S2MU106 is not set
# CONFIG_ERD_CHARGER_S2MU106 is not set
# CONFIG_ERD_MFD_S2MU106 is not set
# CONFIG_ERD_LEDS_S2MU106_FLASH is not set
# CONFIG_ERD_PM_S2MU106 is not set
# CONFIG_ERD_MANAGER_S2M_CHARGER is not set
# CONFIG_ERD_S2M_THERMAL is not set
```

## arch/arm64/configs/s5e3830-base_defconfig
```kconfig
# s5E3830 SOC COMMON config
# SOC ARCH
CONFIG_ARCH_EXYNOS=y
CONFIG_SOC_S5E3830=y
CONFIG_SERIAL_EXYNOS=m
CONFIG_COMMON_CLK_SAMSUNG=y
CONFIG_PINCTRL_SAMSUNG=m
CONFIG_CLKSRC_EXYNOS_MCT=m
CONFIG_CAL_IF=m
CONFIG_CMUCAL_DEBUG=m
CONFIG_CMUCAL_QCH_IGNORE_SUPPORT=m
CONFIG_EXYNOS_FLEXPMU_DBG=m
CONFIG_EXYNOS_ACPM=m
CONFIG_EXYNOS_ACPM_MFD_BUS=m
CONFIG_ACPM_DVFS=m
CONFIG_EXYNOS_PM=m
CONFIG_COMPOSITE_CLK_SAMSUNG=m
CONFIG_EXYNOS_PMU=m
CONFIG_EXYNOS_PD=m
CONFIG_EXYNOS_PD_DBG=m
CONFIG_EXYNOS_FLEXPMU_DBG=m
CONFIG_I2C_CHARDEV=m
CONFIG_I2C_EXYNOS5=m
CONFIG_I2C_S3C2410=m
CONFIG_SPI_S3C64XX=m
CONFIG_USI_V2=m
CONFIG_DMABUF_SAMSUNG_HEAPS=m
CONFIG_DMABUF_HEAPS_SAMSUNG_CMA=y
CONFIG_DMABUF_HEAPS_SAMSUNG_CARVEOUT=y
CONFIG_DMABUF_HEAPS_SAMSUNG_SYSTEM=y
CONFIG_DMABUF_HEAPS_SAMSUNG_CHUNK=y
CONFIG_SAMSUNG_IOMMU=m

#CPUIDLE
# CONFIG_EXYNOS_CPUPM is not set

# PMIC
CONFIG_MFD_S2MPU12=m
CONFIG_REGULATOR_S2MPU12=m
CONFIG_DRV_SAMSUNG_PMIC=m
CONFIG_RTC_DRV_S2MPU12=m
CONFIG_KEYBOARD_S2MPU12=m

#MMC
CONFIG_MMC_DW=m
CONFIG_MMC_DW_EXYNOS=m
CONFIG_MMC_DW_EXYNOS_FMP=y
CONFIG_MMC_DW_DEBUG=m
CONFIG_MMC_CQHCI=m
CONFIG_FB=m
CONFIG_EXYNOS_DPU30=m
#Disable HIBERNATION and WINDOW_UPDATE features for Video Mode
CONFIG_EXYNOS_WINDOW_UPDATE=y
CONFIG_EXYNOS_HIBERNATION=y
CONFIG_EXYNOS_DSIM_DITHER=y
CONFIG_EXYNOS_COMMON_PANEL=y
CONFIG_PHY_EXYNOS_MIPI=m
CONFIG_PHY_EXYNOS_MIPI_DSIM=m
CONFIG_MMC_SRPMB=m

#Touch
# CONFIG_TOUCHSCREEN_SYNAPTICS_I2C_DSX is not set

# CAMERA
# CONFIG_VIDEO_EXYNOS_PABLO_ISP is not set
# CONFIG_VIDEO_EXYNOS_CAMERA_POSTPROCESS is not set
# CONFIG_VIDEO_EXYNOS_CAMERA_POSTPROCESS_GDC is not set
# CONFIG_CAMERA_PP_GDC_V1_0_0_OBJ is not set
# CONFIG_VIDEO_EXYNOS_CAMERA_POSTPROCESS_VOTF is not set
# CONFIG_DISABLE_CAMERA_MEM_ATTR is not set
# CONFIG_DISABLE_CAMERA_SIMD is not set
# CONFIG_PABLO_OBTE_SUPPORT=m

# HW_RANDOM
# CONFIG_HW_RANDOM_EXYNOS_SWD is not set

CONFIG_LTO_CLANG=y
CONFIG_LTO_CLANG_THIN=y

#DEBUG
# CONFIG_PRINTK_CALLER is not set
CONFIG_PRINTK_PROCESS=y
CONFIG_EXYNOS_DEBUG=y
CONFIG_DEBUG_SNAPSHOT=m
CONFIG_DEBUG_SNAPSHOT_SFRDUMP=m
CONFIG_DEBUG_SNAPSHOT_QUICKDUMP=m
CONFIG_DEBUG_SNAPSHOT_DEBUG_KINFO=m
CONFIG_EXYNOS_DEBUG_TEST=m
CONFIG_EXYNOS_CORESIGHT=m
CONFIG_EXYNOS_ECC_HANDLER=m
CONFIG_EXYNOS_HARDLOCKUP_WATCHDOG=m
CONFIG_EXYNOS_ITMON=m
CONFIG_EXYNOS_SSLD=m
CONFIG_EXYNOS_EHLD=m

CONFIG_EXYNOS_BCM_DBG=m
#CONFIG_EXYNOS_BCM_DBG_GNR=y

#WDT
CONFIG_S3C2410_WATCHDOG=m
CONFIG_S3C2410_SHUTDOWN_REBOOT=y
CONFIG_S3C2410_BUILTIN_WATCHDOG=y

#Reboot
CONFIG_EXYNOS_REBOOT=m

CONFIG_ECT=m
CONFIG_EXYNOS_PM_QOS=y
CONFIG_EXYNOS_DVFS_MANAGER=m

CONFIG_ARM_EXYNOS_DEVFREQ=m
CONFIG_ARM_EXYNOS_DEVFREQ_DEBUG=m

CONFIG_ARM_EXYNOS_ACME=m
CONFIG_ARM_FREQ_QOS_TRACER=m
CONFIG_CPU_IDLE_GOV_HALO=y
CONFIG_EXYNOS_UFCC=m

#CPU
CONFIG_EXYNOS_CPUHP=m
CONFIG_EXYNOS_BTS=m

# EMS
CONFIG_SCHED_EMS=m
CONFIG_SCHED_EMS_TUNE=y
CONFIG_SCHED_EMS_DEBUG=y
CONFIG_VENDOR_NR_CPUS=8
CONFIG_EXYNOS_PERF=m
CONFIG_CPU_FREQ_GOV_ENERGYSTEP=y
CONFIG_CPU_FREQ_GOV_ENERGYAWARE=y

#WLAN
# CONFIG_WEXT_PROC is not set
# CONFIG_WEXT_CORE is not set
# CONFIG_WIRELESS is not set
# CONFIG_CFG80211_REG_NOT_UPDATED is not set
# CONFIG_SCSC_WLBT_CONFIG_PLATFORM is not set
# CONFIG_SCSC_CORE is not set
# CONFIG_SCSC_CORE_FW_LOCATION is not set
# CONFIG_SCSC_LOGRING is not set
# CONFIG_SCSC_WLBTD is not set
# CONFIG_SCSC_LOG_COLLECTION is not set
# CONFIG_SCSC_PLATFORM is not set
# CONFIG_SCSC_CM_MX_CLIENT_TEST is not set
# CONFIG_SCSC_FM is not set
# CONFIG_SCSC_FM_TEST is not set
# CONFIG_SCSC_MMAP is not set
# CONFIG_SCSC_DBG_SAMPLER is not set
# CONFIG_SCSC_DEBUG_COMPATIBILITY is not set
# CONFIG_SCSC_DEBUG is not set
# CONFIG_SCSC_STATIC_RING is not set
# CONFIG_SCSC_STATIC_RING_SIZE is not set
# CONFIG_SCSC_WIFILOGGER is not set
# CONFIG_SCSC_BT is not set
# CONFIG_SCSC_WLAN is not set
# CONFIG_SCSC_SMAPPER is not set
# CONFIG_SCSC_COMMON_HCF is not set
# CONFIG_SCSC_WLAN_WIFI_SHARING is not set
# CONFIG_SCSC_WLAN_SAE_CONFIG is not set
# CONFIG_SCSC_WLAN_ENABLE_MAC_RANDOMISATION is not set
# CONFIG_SCSC_WLAN_SINGLE_ANTENNA is not set
# CONFIG_SCSC_WIFI_NAN_ENABLE is not set
# CONFIG_SCSC_LOGRING_DEBUGFS is not set
# CONFIG_SCSC_WLAN_MHS_STATIC_INTERFACE is not set
# CONFIG_SCSC_MX152_EXT_DUAL_FEM is not set
# CONFIG_SCSC_WIFILOGGER_DEBUGFS is not set

#FM Radio
# CONFIG_VIDEO_V4L2 is not set
# CONFIG_RADIO_ADAPTERS is not set
# CONFIG_RADIO_S5E3830 is not set
# CONFIG_RADIO_S610 is not set
# CONFIG_MEDIA_SUBDRV_AUTOSELECT is not set

#GNSSIF
# CONFIG_GNSS_PMUCAL is not set
# CONFIG_EXYNOS_GNSS_IF is not set

#MM
# CONFIG_VIDEO_EXYNOS_MFC is not set
# CONFIG_VIDEO_EXYNOS_SCALER is not set
# CONFIG_VIDEO_EXYNOS_SMFC is not set

#NANOHUB
# CONFIG_SHUB_PMUCAL is not set
# CONFIG_NANOHUB is not set
# CONFIG_SENSOR_DRV is not set

#ADC
CONFIG_EXYNOS_ADC=m

#PWM
CONFIG_PWM_SAMSUNG=m

CONFIG_EXYNOS_THERMAL_V2=m
CONFIG_EXYNOS_ACPM_THERMAL=m
CONFIG_EXYNOS_CPU_THERMAL=m
CONFIG_GPU_THERMAL=m
CONFIG_PL330_DMA=m

#audio
# CONFIG_SND_SOC_SAMSUNG is not set
# CONFIG_SND_SOC_SAMSUNG_ABOX_DEBUG is not set

#MODEMIF
# CONFIG_EXYNOS_MODEM_IF is not set
# CONFIG_SEC_MODEM_S5000AP is not set
# CONFIG_CP_UART_NOTI is not set
# CONFIG_PMU_UART_SWITCH is not set
# CONFIG_CP_BTL is not set
# CONFIG_LINK_DEVICE_WITH_SBD_ARCH is not set

# codec
# CONFIG_SND_SOC_AUD3004X_5PIN is not set
# CONFIG_SND_SOC_AUD3004X_6PIN is not set
# CONFIG_SND_SOC_AUD3004X_DUMP is not set
# CONFIG_SND_SOC_AUD3004X_EXT_ANT is not set

#zram
CONFIG_ZSMALLOC=m
CONFIG_ZRAM=m

# LEDS
CONFIG_LEDS_GPIO=y
CONFIG_LEDS_TRIGGERS=y
CONFIG_LEDS_TRIGGER_HEARTBEAT=y
CONFIG_LEDS_TRIGGER_PANIC=y

# ---- USB (original Samsung options) ----
CONFIG_USB_DWC3_EXYNOS_MODULE=y
CONFIG_USB_XHCI_EXYNOS=y
CONFIG_USB_CONFIGFS_F_DM=m
CONFIG_USB_CONFIGFS_RNDIS=y
# CONFIG_USB_PORT_POWER_OPTIMIZATION is not set
# CONFIG_USB_EXYNOS_TPMON_MODULE is not set
CONFIG_PHY_EXYNOS_USBDRD=y
CONFIG_EXYNOS_CHIPID_V2=m

# ---- USB ----
CONFIG_REGULATOR=y
CONFIG_REGULATOR_FIXED_VOLTAGE=y
CONFIG_NET=y
CONFIG_INET=y
CONFIG_USB=y
CONFIG_EXTCON=y
CONFIG_USB_DWC3=y
CONFIG_USB_DWC3_DUAL_ROLE=y
CONFIG_USB_OTG=y
CONFIG_USB_OTG_FSM=y
CONFIG_USB_CONN_GPIO=y
CONFIG_USB_XHCI_HCD=y
CONFIG_USB_ANNOUNCE_NEW_DEVICES=y
CONFIG_USB_GADGET=y
CONFIG_USB_CONFIGFS=y
CONFIG_USB_CONFIGFS_ACM=y
CONFIG_USB_CONFIGFS_RNDIS=y
CONFIG_PHY_EXYNOS_USBDRD=y
# CONFIG_PHY_EXYNOS5_USBDRD is not set

# ---- Ethernet ----
CONFIG_NETDEVICES=y
CONFIG_USB_USBNET=y
CONFIG_USB_NET_SMSC95XX=y
```

## drivers/misc/samsung/muic/Kconfig
```kconfig
#
# MUIC devices
#

comment "MUIC configs"

source "drivers/misc/samsung/muic/common/Kconfig"

config ERD_MUIC_SAMSUNG_IFPMIC
	tristate "Using common MUIC device driver"
	depends on I2C
	default n
	help
	  If you say yes here you will get support for
	  the common MUIC device driver.

config ERD_USE_S2M_MUIC
	tristate "Using S2M MUIC device driver"
	depends on I2C
	default n
	help
	  If you say yes here you will get support for
	  the MUIC device driver.

config ERD_MUIC_SUPPORT_CCIC
	bool "MUIC supports CCIC chip interface"
	depends on ERD_USE_S2M_MUIC
	default n
	help
	  If you say yes here you will get support for the CCIC chip.

config ERD_MUIC_SYSFS
	bool "Using muic sysfs Features"
	depends on ERD_USE_S2M_MUIC
	default n
	help
	  If you say yes here you will get support for the muic sysfs.

config ERD_MUIC_SUPPORT_PRSWAP
	bool "MUIC supports power role swap"
	depends on ERD_USE_S2M_MUIC
	default n
	help
	  If you say yes here you will get support for the power role swap.

config ERD_MUIC_S2MU106
	tristate "Using S2MU106 MUIC"
	depends on ERD_USE_S2M_MUIC# && ERD_MFD_S2MU106
	default n
	help
	  If you say yes here you will get support for the S2MU106 MUIC chip.

config ERD_MUIC_S2MU106_RID
	bool "Using S2MU106 MUIC RID"
	depends on ERD_MUIC_S2MU106
	default n
	help
	  If you say yes here you will get support for the S2MU106 MUIC RID functions.

config ERD_S2MU106_MUIC_STABLE_RESET
	bool "Using S2MU106 MUIC rescan when booting"
	depends on ERD_MUIC_S2MU106
	default n
	help
	  If you say yes here you will get support for the S2MU106 muic booting rescan

config ERD_MUIC_S2MF301
	tristate "Using S2MF301 MUIC"
	depends on ERD_USE_S2M_MUIC# && MFD_S2MF301
	default n
	help
	  If you say yes here you will get support for the S2MF301 MUIC chip.

config ERD_MUIC_S2MF301_RID
	bool "Using S2MF301 MUIC RID"
	depends on ERD_MUIC_S2MF301
	default n
	help
	  If you say yes here you will get support for the S2MF301 MUIC RID functions.

config ERD_S2MF301_MUIC_STABLE_RESET
	bool "Using S2MF301 MUIC rescan when booting"
	depends on ERD_MUIC_S2MF301
	default n
	help
	  If you say yes here you will get support for the S2MF301 muic booting rescan

config ERD_S2MF301_MUIC_SDP_OVP_OFF
	bool "Using S2MF301 MUIC support fs usb"
	depends on ERD_USE_S2M_MUIC
	default n
	help
	  If you say yes here you will get support for the S2MF301 MUIC chip.
```

## drivers/misc/samsung/muic/common/Kconfig
```kconfig
#
# MUIC devices
#

comment "MUIC configs"

config ERD_MUIC_MANAGER
	bool "MUIC Manager supports PDIC chip interface"
	depends on ERD_USE_S2M_MUIC
	default n
	help
	  If you say yes here you will get support manager for the PDIC chip.

config ERD_MUIC_CORE
	bool "Supports MUIC Core"
	depends on ERD_USE_S2M_MUIC
	default n
	help
	  If you say yes here you will get support for the MUIC Core functionalities
```

## drivers/usb/typec/samsung/Kconfig
```kconfig
#
# PDIC devices
#

comment "PDIC configs"

config ERD_TYPEC_SAMSUNG_IFPMIC
	tristate "Using common USBPD device driver"
	depends on I2C
	default n
	help
	  If you say yes here you will get support for
	  the common USB PD(Power Delivery) device driver.

config ERD_USE_S2M_PDIC
	tristate "Using USBPD device driver"
	depends on I2C
	default n
	help
	  If you say yes here you will get support for
	  the USB PD(Power Delivery) device driver.

config ERD_PDIC_S2MU106
	bool "Using S2MU106 USB PD"
	depends on ERD_USE_S2M_PDIC
	default n
	help
		If you say yes here you will get support for
		the S2MU106 USBPD chip

config ERD_PDIC_S2MF301
	bool "Using S2MF301 USB PD"
	depends on ERD_USE_S2M_PDIC
	default n
	help
		If you say yes here you will get support for
		the S2MF301 USBPD chip

config ERD_PDIC_SYSFS
	bool "Using PDIC SYSFS System"
	depends on ERD_USE_S2M_PDIC
	default n
	help
	  If you say yes here you will get support for
	  sysfs system.

config ERD_PDIC_AUDIO_ACC
	bool "Using PDIC Audio accessory support(Ra-Ra)"
	depends on ERD_USE_S2M_PDIC
	default n
	help
	  If you say yes here you will get support for
	  Audio Accessory support (need usb audio switch device)

config ERD_CHECK_CTYPE_SIDE
	bool "Using Check Side of Type-C PLUG"
	help
		This Config for function that check side of Type-C PLUG for USB

config ERD_SUPPORT_USB_TYPEC_OPS
	bool "Using USB_TYPEC_OPS for GKI"
	help
		This config ERD_for support typec_ops for GKI

config ERD_USB_SW_MAX20328B
	bool "MAX20328B USB Switch driver"
	help
		This driver is for MAX20328B USB switch that use I2C interface
		To compile this driver as a module, choose M here: the
		module will be called max20328b

config ERD_PDIC_SUPPORT_DP
	tristate "Support booting with DP"
	help
		This Config for function that support DP

config ERD_PDIC_PD30
	bool "Support PD30"
	help
		This Config for function that support PD30
```

## drivers/video/fbdev/exynos/Kconfig
```kconfig
if SOC_S5E3830

source "drivers/video/fbdev/exynos/dpu30/Kconfig"

endif # SOC_S5E3830
```

## drivers/video/fbdev/exynos/dpu30/Kconfig
```kconfig
config EXYNOS_DPU20
	bool "Samsung Exynos Display system (DPP, DECON, MIPI, HDMI)"
	default n
	depends on FB

if EXYNOS_DPU20
config EXYNOS_DECON_FB
	bool "Samsung DECON Framebuffer driver"
	depends on EXYNOS_DPU20
	default y
	help
	  Say Y here if you want support for the DECON in Samsung S5P SoCs.
	  This device produce image data to one of output interfaces.

config EXYNOS_DPP
	bool "Samsung Exynos Display Post Processor driver"
	depends on EXYNOS_DPU20
	default y

config EXYNOS_MIPI_DSIM
	bool "Samsung Exynos MIPI-DSI driver"
	depends on EXYNOS_DPU20
	default y
	help
	  Enable MIPI-DSI driver.

config EXYNOS_DISPLAYPORT
	bool "Samsung Exynos DISPLAYPORT driver"
	depends on EXYNOS_DPU20
	default y
	help
	  Enable DISPLAYPORT driver.

config EXYNOS_ZEBU_EMUL_DISP
	bool "Zebu Emulator Display driver"
	depends on EXYNOS_DPU20
	default n

config FB_WINDOW_UPDATE
        bool "DECON window update mode"
        depends on EXYNOS_DPU20
        default n

config DECON_BLOCKING_MODE
	bool "DECON blocking mode"
        depends on EXYNOS_DPU20
        default y

config DECON_EVENT_LOG
	bool "Display sub-system event logger (DECON/DSIM/DPP)"
        depends on DEBUG_INFO && EXYNOS_DPU20
        default y

config DECON_HIBER
	bool "DECON hiber mode"
        depends on EXYNOS_DPU20
        default n

config SUPPORT_DOZE
	bool "Support DOZE mode for AOD service"
        depends on EXYNOS_DPU20
        default n

config EXYNOS_AFBC
	bool "Display sub-system AFBC stream"
        depends on EXYNOS_DPU20
        default n

config EXYNOS_DSIM_DITHER
	bool "DSIM SSCG feature"
        depends on EXYNOS_MIPI_DSIM
        default y

config DECON_BTS_LEGACY
	bool "Legacy BTS scheme of display"
        depends on EXYNOS_DPU20
        default n

config DPU_2_0_FENCE
	bool "fence is signaled at the beginning of a frame"
        depends on EXYNOS_DPU20
        default n

config FB_TEST
	bool "FB test only"
        depends on EXYNOS_DPU20
        default n

config DSIM_CMD_TEST
	bool "DSIM command test only"
        depends on EXYNOS_DPU20
        default n

config DPU_2_0_RELEASE_FENCES
	bool "Release fence FD is created per each enable window"
        depends on EXYNOS_DPU20
        default n

config EXYNOS_MULTIRESOLUTION
	bool "Multi resolution LCD support"
	depends on EXYNOS_DPU20 && FB_WINDOW_UPDATE
	default y

config EXYNOS_VIRTUAL_DISPLAY
	bool "Virtual display mode"
	depends on EXYNOS_DPU20

config EXYNOS_LOW_PERSISTENCE
	bool "Support low persistence mode"
        depends on EXYNOS_DPU20

endif

source "drivers/video/fbdev/exynos/dpu20/panels/Kconfig"
```

## drivers/video/fbdev/exynos/dpu30/panels/Kconfig
```kconfig
config EXYNOS_COMMON_PANEL
	depends on EXYNOS_DPU30
	default n
	bool "Support Exynos Common Panel Driver"
```
